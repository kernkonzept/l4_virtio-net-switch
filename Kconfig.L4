## Kconfig.L4
```kconfig
menu "Virtual network switch"

config VNS_PORT_FILTER
	bool "Support port filtering"
	help
	  This enables the filter path in the virtual network switch.
	  The filter must be filled with actual filter code to do
	  something useful.

	  If unsure, select N.

comment "Ixl ports not available due to missing libixl"
	depends on !HAVE_BIDPC_IXL

config VNS_IXL
	bool "Support Ixl ports"
	depends on HAVE_BIDPC_IXL
	help
	  This enables adding Ixl network ports to the virtual network switch.

config VNS_STATS
	bool "Enable statistics interface"
	help
	  This enables port statistics.

	  If unsure, select N.

endmenu
```
